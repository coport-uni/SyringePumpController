## firmware/main/Kconfig.projbuild
```kconfig
menu "Syringe Pump Client"

    config PUMP_SERVER_URL
        string "Pump server base URL"
        default "http://192.168.1.129:17046"
        help
            Base URL of the sy01b-server FastAPI bridge running on the
            PC host. The firmware appends "/v1/..." paths. NVS can
            override this at runtime (config_store.c) without reflash.

    config PUMP_WIFI_SSID
        string "WiFi SSID"
        default ""
        help
            LAN access point SSID. Leave blank to require NVS-only
            provisioning. Empty default refuses to compile a real
            credential into the binary.

    config PUMP_WIFI_PASSWORD
        string "WiFi password"
        default ""
        help
            WPA2 passphrase for CONFIG_PUMP_WIFI_SSID. Same NVS
            override path as the SSID.

    config PUMP_WIFI_MAX_RETRY
        int "WiFi connect retry count"
        default 5
        range 1 100
        help
            Initial connect attempt limit before backoff kicks in.

    config PUMP_HTTP_TIMEOUT_MS
        int "HTTP client read timeout (ms)"
        default 10000
        range 1000 120000
        help
            Per-request read timeout. Long ops (prime ~30 s) are not
            issued by Phase B, but the budget should cover them in
            Phase C without raising this further.

    config PUMP_STATUS_POLL_INTERVAL_MS
        int "Status tab refresh interval (ms)"
        default 2000
        range 500 60000
        help
            How often the Status tab fetches GET /v1/status when the
            tab is visible. The poll is paused when a different tab
            is active.

endmenu
```

## firmware/sdkconfig.defaults
```kconfig
# Base sdkconfig defaults for sy01b-client. Target-specific overrides
# live in sdkconfig.defaults.esp32s3.

# --- Target ---
CONFIG_IDF_TARGET="esp32s3"

# --- Partitions ---
CONFIG_PARTITION_TABLE_CUSTOM=y
CONFIG_PARTITION_TABLE_CUSTOM_FILENAME="partitions.csv"
CONFIG_PARTITION_TABLE_FILENAME="partitions.csv"

# --- FreeRTOS ---
CONFIG_FREERTOS_HZ=1000

# --- HTTP client ---
# Larger response buffer for diagnose payload (~300 B today, headroom
# for Phase C error envelopes). Keep TLS off — LAN-only plaintext.
CONFIG_HTTPD_MAX_REQ_HDR_LEN=1024
CONFIG_ESP_TLS_INSECURE=y

# --- Log level ---
CONFIG_LOG_DEFAULT_LEVEL_INFO=y

# --- WiFi ---
CONFIG_ESP_WIFI_SOFTAP_SUPPORT=n
CONFIG_ESP_WIFI_STATIC_RX_BUFFER_NUM=10
CONFIG_ESP_WIFI_DYNAMIC_TX_BUFFER_NUM=32

# --- LVGL ---
# BSP picks LVGL config; we just make sure double-buffering uses PSRAM.
CONFIG_BSP_DISPLAY_LVGL_BUF_PSRAM=y
```

## firmware/sdkconfig.defaults.esp32s3
```kconfig
# ESP32-S3-BOX-3 specific overrides. Octal PSRAM @ 80 MHz; quad mode
# will hang the BSP display init.

CONFIG_ESPTOOLPY_FLASHSIZE_16MB=y
CONFIG_ESPTOOLPY_FLASHFREQ_80M=y
CONFIG_ESPTOOLPY_FLASHMODE_QIO=y

CONFIG_SPIRAM=y
CONFIG_SPIRAM_MODE_OCT=y
CONFIG_SPIRAM_SPEED_80M=y
CONFIG_SPIRAM_USE_MALLOC=y
CONFIG_SPIRAM_TRY_ALLOCATE_WIFI_LWIP=y

CONFIG_ESP_DEFAULT_CPU_FREQ_MHZ_240=y
```
